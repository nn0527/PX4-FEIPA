## src/modules/ceiling_reader/Kconfig
```kconfig
menuconfig MODULES_CEILING_READER
	bool "ceiling_reader"
	default n
	---help---
		Enable the ESP32 distance-frame to distance_sensor bridge.
```

## src/modules/uart_rx/Kconfig
```kconfig
menuconfig MODULES_UART_RX
	bool "uart_rx"
	default n
	---help---
		Enable the ESP32 UART receiver for 9-byte dual-range frames:
		AA 55 UP_H UP_L FWD_H FWD_L CRC 0D 0A. CRC-8/ATM is calculated
		over bytes 0 through 5.
```

## src/modules/wall_perch/Kconfig
```kconfig
menuconfig MODULES_WALL_PERCH
	bool "wall_perch"
	default n
	---help---
		Enable the wall perching maneuver module for wall-contact UAV operations.
```
